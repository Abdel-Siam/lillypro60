## boards/shields/Kconfig.defconfig
```kconfig
if SHIELD_ERGOS1_RIGHT
    config ZMK_KEYBOARD_NAME
        default "ErgoS1"

    config ZMK_SPLIT_BLE_ROLE_CENTRAL
        default y

endif



if SHIELD_ERGOS1_LEFT || SHIELD_ERGOS1_RIGHT

    config ZMK_SPLIT
        default y
endif
```

## boards/shields/Kconfig.shield
```kconfig
config SHIELD_ERGOS1_LEFT
	def_bool $(shields_list_contains,ergos1_left)

config SHIELD_ERGOS1_RIGHT
	def_bool $(shields_list_contains,ergos1_right)
```
